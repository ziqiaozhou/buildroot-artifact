## package/ifupdown-scripts/Config.in
```kconfig
config BR2_PACKAGE_IFUPDOWN_SCRIPTS
	bool "ifupdown scripts"
	default y if BR2_ROOTFS_SKELETON_DEFAULT
	depends on !BR2_PACKAGE_SYSTEMD_NETWORKD && !BR2_PACKAGE_NETIFRC
	help
	  Set of scripts used by ifupdown (either the standalone one,
	  or the busybox one) to bring network up, or tear it down.

config BR2_PACKAGE_IFUPDOWN_SCRIPTS_CHOICE
	string "ifupdown scripts name"
	default "S40network"
```

## package/libtpms/Config.in
```kconfig
config BR2_PACKAGE_LIBTPMS
	bool "libtpms"
    depends on BR2_INSTALL_LIBSTDCPP
	help
	  Simple DirectMedia Layer - SDL is a library that allows
	  programs portable low level access to a video framebuffer,
	  audio output, mouse, and keyboard.

	  http://www.libsdl.org/
```

## package/swtpm/Config.in
```kconfig
config BR2_PACKAGE_SWTPM
	bool "swtpm"
    depends on BR2_PACKAGE_LIBTPMS
	depends on BR2_PACKAGE_JSON_GLIB
	depends on BR2_PACKAGE_LIBFUSE
	depends on BR2_PACKAGE_LIBSECCOMP
	depends on BR2_PACKAGE_EXPECT
	depends on BR2_PACKAGE_LIBTASN1
	depends on BR2_PACKAGE_TCL
	depends on BR2_PACKAGE_GNUTLS
	help
	  SWTPM for qemu
```

## package/tss_msr/Config.in
```kconfig
config BR2_PACKAGE_TSS_MSR
	bool "tss.msr"
	depends on BR2_PACKAGE_PYTHON3
	help
	  TSS.MSR
```
